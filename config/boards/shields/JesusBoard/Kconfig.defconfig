## config/boards/shields/JesusBoard/Kconfig.defconfig
```kconfig
if SHIELD_JESUS_LEFT

config ZMK_KEYBOARD_NAME
    default "JesusBoard"

config ZMK_SPLIT_BLE_ROLE_CENTRAL
    default y

endif

if SHIELD_JESUS_LEFT || SHIELD_JESUS_RIGHT

config ZMK_SPLIT
    default y

endif
```

## config/boards/shields/JesusBoard/Kconfig.shield
```kconfig
config SHIELD_JESUS_LEFT
	def_bool $(shields_list_contains,jesus_left)

config SHIELD_JESUS_RIGHT
	def_bool $(shields_list_contains,jesus_right)
```
